#include <TensorFlowLite.h>

// include our converted model (header file int8)
#include "model_data.h"

#include "tensorflow/lite/micro/all_ops_resolver.h"
#include "tensorflow/lite/micro/micro_interpreter.h"
#include "tensorflow/lite/micro/micro_log.h"
#include "tensorflow/lite/micro/system_setup.h"
#include "tensorflow/lite/schema/schema_generated.h"

// Globals, used for compatibility with Arduino-style sketches.
namespace 
{

  unsigned long startMicros;
  unsigned long endMicros;
  unsigned long elapsedMicros;
  
const tflite::Model* model = nullptr;
tflite::MicroInterpreter* interpreter = nullptr;
TfLiteTensor* input = nullptr;
TfLiteTensor* output = nullptr;

// block of memory needed for the interpreter tensors 
constexpr int kTensorArenaSize = 200000;

// Keep aligned to 16 bytes for CMSIS
alignas(16) uint8_t tensor_arena[kTensorArenaSize];

}  // namespace

// The name of this function is important for Arduino compatibility.
void setup() 
{
  tflite::InitializeTarget();

  // loading the model 
  // Map the model into a usable data structure. This doesn't involve any
  // copying or parsing, it's a very lightweight operation.
  model = tflite::GetModel(g_model);

  // check the model version 
  if (model->version() != TFLITE_SCHEMA_VERSION) 
  {
    MicroPrintf(
        "Model provided is schema version %d not equal "
        "to supported version %d.",
        model->version(), TFLITE_SCHEMA_VERSION);
    return;
  }

  // load the required TFLM interpreter functions (here we are addding all ops) 
  // This pulls in all the operation implementations we need.
  // NOLINTNEXTLINE(runtime-global-variables)
  static tflite::AllOpsResolver resolver;

  // Build an interpreter to run the model with.
  static tflite::MicroInterpreter static_interpreter(
      model, resolver, tensor_arena, kTensorArenaSize);
  interpreter = &static_interpreter;

  // Allocate memory from the tensor_arena for the model's tensors.
  TfLiteStatus allocate_status = interpreter->AllocateTensors();
  if (allocate_status != kTfLiteOk) {
    MicroPrintf("AllocateTensors() failed");
    return;
  }

  // Obtain pointers to the model's input and output tensors.
  input = interpreter->input(0);
  output = interpreter->output(0);

  // initialize serial communication at 9600 bits per second:
  Serial.begin(9600);
}//end setup 

// The name of this function is important for Arduino compatibility.
void loop() 
{
  // create a test sample
  // float x = 1.6;
  float x[800] = {0.440975876,0.406197657,0.421517045,0.470764277,0.510701062,0.509067038,0.477486161,0.460279838,0.486202344,0.534048619,0.553261373,0.5193428,0.462161717,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0.393573244,0.367070086};

  // Quantize the input from floating-point to integer
  // int8_t x_quantized = x / input->params.scale + input->params.zero_point;
  // Define the quantized int8_t array
  int8_t x_quantized[800];

  for (int i = 0; i < 800; i++) 
  {
    x_quantized[i] = static_cast<int8_t>(x[i] / input->params.scale + input->params.zero_point);
  }
  
  // Serial.println(x[1]);
  // Serial.println(input->params.zero_point);
  // Serial.println(input->params.scale);
  // Serial.println(x_quantized[1]);
  // Serial.println("");

  // Place the quantized input in the model's input tensor
  // input->data.int8[0] = x_quantized;
  // Copy the quantized input into the model's input tensor
  for (int i = 0; i < 800; i++) 
  {
    input->data.int8[i] = x_quantized[i];
  }

   //////////////////////////////////////// Record the start time
  startMicros = micros();

  // Run inference, and report any error
  TfLiteStatus invoke_status = interpreter->Invoke();

    // Record the end time
  endMicros = micros();
  // calculate the elapsed time
  elapsedMicros = endMicros - startMicros;

  if (invoke_status != kTfLiteOk) 
  {
    // MicroPrintf("Invoke failed on x: %f\n", static_cast<double>(x));
    return;
  }

  // Obtain the quantized output from model's output tensor
  // int8_t y_quantized = output->data.int8[0];
  
  // Dequantize the output from integer to floating-point
  // float y = (y_quantized - output->params.zero_point) * output->params.scale;
  // Serial.println(y_quantized);
  // Serial.println(output->params.zero_point);
  // Serial.println(output->params.scale);
  // Serial.println(y);
  // Serial.println("");

   // print the output tensor (800)
    for (int i = 0; i < 800; i++) 
    {
      int8_t y_quantized = output->data.int8[i];
      float y_val = (y_quantized - output->params.zero_point) * output->params.scale;
      Serial.print(y_val);
      Serial.print(",");
      // vTaskDelay(pdMS_TO_TICKS(1)); // Delay for 1 milliseconds
      delay(0.1);
    }//end for
    Serial.println("");
    // print the elapsed time 
    Serial.println(elapsedMicros);

  // delay 1 second 
  delay(1);

}//end loop 
